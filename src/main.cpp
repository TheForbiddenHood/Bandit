// Libraries we need for this program to work (no need to reinvent the wheel!)
#include <Arduino.h>
#include <Wire.h>
#include <Adafruit_GFX.h>
#include <Adafruit_SSD1306.h>

// These are the buttons we'll be using
#define LIFE_BUTTON 12
#define FUN_BUTTON 14

// These are the OLED pins
#define SCREEN_SCL 22
#define SCREEN_SDA 21

// These are our colored LEDs for debugging
#define RED 18
#define BLUE 15

// Here we'll define some crucial integer values that will run most of the application.
const int MaxLife = 100;
const int DecAmt = 1;
const int DecTime = 1000;
const int BLINK = 500;

// These are the definitions for the OLED display (0.96 OLED Display)
#define SCREEN_WIDTH 128
 #define SCREEN_HEIGHT 64
#define SCREEN_RESET -1
#define SCREEN_ADDRESS 0x3C

// Create the display
Adafruit_SSD1306 display(SCREEN_WIDTH, SCREEN_HEIGHT, &Wire, SCREEN_RESET);

// These are the bitmaps for displays (Highly recommend that you minimize these variables if looking at the code)

// This is the first screen with the normal heart size
const unsigned char epd_bitmap_DefaultScreenTwo [] PROGMEM = {
	0xff, 0xff, 0xff, 0xff, 0xff, 0xff, 0xff, 0xff, 0xff, 0xff, 0xff, 0xff, 0xff, 0xff, 0xff, 0xff, 
	0xff, 0xff, 0xff, 0xff, 0xff, 0xff, 0xff, 0xff, 0xff, 0xff, 0xff, 0xff, 0xfc, 0x63, 0xf8, 0x03, 
	0xff, 0xff, 0xff, 0xff, 0xff, 0xff, 0xff, 0xff, 0xff, 0xff, 0xff, 0xff, 0xfb, 0x9d, 0xf7, 0xfd, 
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	0xff, 0xff, 0xff, 0xff, 0xff, 0xff, 0xff, 0xff, 0xff, 0xff, 0xff, 0xff, 0xff, 0xff, 0xff, 0xff
};

// This is the same as the first screen, with a smaller heart size (for heartbeats)
const unsigned char epd_bitmap_HeartBeatTwo [] PROGMEM = {
	0xff, 0xff, 0xff, 0xff, 0xff, 0xff, 0xff, 0xff, 0xff, 0xff, 0xff, 0xff, 0xff, 0xff, 0xff, 0xff, 
	0xff, 0xff, 0xff, 0xff, 0xff, 0xff, 0xff, 0xff, 0xff, 0xff, 0xff, 0xff, 0xff, 0xff, 0xf8, 0x03, 
	0xff, 0xff, 0xff, 0xff, 0xff, 0xff, 0xff, 0xff, 0xff, 0xff, 0xff, 0xff, 0xfe, 0x67, 0xf7, 0xfd, 
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	0xff, 0xff, 0xff, 0xff, 0xff, 0xff, 0xff, 0xff, 0xff, 0xff, 0xff, 0xff, 0xff, 0xff, 0xff, 0xff
};

// This is the "Later Partner" screen
const unsigned char epd_bitmap_DeathScreenTwo [] PROGMEM = {
	0xff, 0xff, 0xff, 0xff, 0xff, 0xff, 0xff, 0xff, 0xff, 0xff, 0xff, 0xff, 0xff, 0xff, 0xff, 0xff, 
	0xff, 0xff, 0xff, 0xff, 0xff, 0xff, 0xff, 0xff, 0xff, 0xff, 0xff, 0xff, 0xff, 0xff, 0xf8, 0x03, 
	0xff, 0xff, 0xff, 0xff, 0xff, 0xff, 0xff, 0xff, 0xff, 0xff, 0xff, 0xff, 0xff, 0xff, 0xf7, 0xfd, 
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	0xff, 0xff, 0xff, 0xff, 0xff, 0xff, 0xff, 0xff, 0xff, 0xff, 0xff, 0xff, 0xff, 0xff, 0xff, 0xff
};

// This is the "Happy face" screen
const unsigned char epd_bitmap_LikeScreenTwo [] PROGMEM = {
	0xff, 0xff, 0xff, 0xff, 0xff, 0xff, 0xff, 0xff, 0xff, 0xff, 0xff, 0xff, 0xff, 0xff, 0xff, 0xff, 
	0xff, 0xff, 0xff, 0xff, 0xff, 0xff, 0xff, 0xff, 0xff, 0xff, 0xff, 0xff, 0xfc, 0x63, 0xf8, 0x03, 
	0xff, 0xff, 0xff, 0xff, 0xff, 0xff, 0xff, 0xff, 0xff, 0xff, 0xff, 0xff, 0xfb, 0x9d, 0xf7, 0xfd, 
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	0xff, 0xff, 0xff, 0xff, 0xff, 0xff, 0xff, 0xff, 0xff, 0xff, 0xff, 0xff, 0xff, 0xff, 0xff, 0xff
};

// integer values that will help with the startup() as well as operating the LifeButton
int life = 5;
int CPR = 5;

// Setup the button & flags for it. (0 = press / 1 = not pressed)
int LastLifeButtonState = 1;
boolean IsLifeButtonPressed = false;

int LastFunButtonState = 1;
boolean IsFunButtonPressed = false;

// We make a quick unsigned long to ensure we don't have any blocks in our timing / as well as the Green LED for Life
unsigned long lastDecTime = 0;
unsigned long lastBlinkTime = 0;

// This will be used for Time of Death calculuations and display on the Death Screen
unsigned long timeElapsed = 0;
unsigned long TimeOfDeath = 0;
void DeathTime();


/*
What's the vision for this little project?
I plan to turn this into a tomogatchi that is based on the Bape Head icons from 2008 (please refer to the Bape Concert Ad)
I want to use a small screen and a regulator to run the v3.7 lipo for a rechargable battery on the device.

What seperates this from a usual tomogatchi?
I want to have bluetooth integration to determine when you listen to music, and use that for musical functionality
such as making the character dance or something for progression.

Since we had issues with the bluetooth, we will circle back to it and for now all mentions of BLE has been removed.
*/

// All code here is executed once on startup
void setup() {
  // This is how we scan for the button later on, it's like a listener
  Serial.begin(9600);

  // Here I'll setup some of the inputs and outputs that reside in the program.

  // This is for the LEDs of color that currently are in use for Debugging
  pinMode(RED, OUTPUT);
  pinMode(BLUE, OUTPUT);

  // This is the button we will use, and we use PULLUP so that the program inverts it by default
  pinMode(LIFE_BUTTON, INPUT_PULLUP);
  pinMode(FUN_BUTTON, INPUT_PULLUP);

  // Set the LEDs to LOW since they will not be used at the beginning of the functions
  digitalWrite(RED, LOW);
  digitalWrite(BLUE, LOW);

  // Set up the OLED Display to correctly operate
  Wire.begin(SCREEN_SDA, SCREEN_SCL);
  
  // Begin Display
  display.begin(SSD1306_SWITCHCAPVCC, SCREEN_ADDRESS);

  // Used to determine the "TimeOfDeath"
  timeElapsed = millis();

}

// This function reads the life button status, flags it, and controls the blue LED for visual confirmation
void readLifeButton(){
 
  // Let's pull the current button state.
  int ButtonStatus = digitalRead(LIFE_BUTTON);

  // Press event (flag IsButtonPressed)
  if (ButtonStatus == 0 && LastLifeButtonState == 1){
    IsLifeButtonPressed = true;
  }

  // This is the logic that controls the blue LED when the button is pressed (for debugging) 
  if (ButtonStatus == 0){
    digitalWrite(BLUE, HIGH);
  } else{
    digitalWrite(BLUE, LOW);
  }

  // Update the last button state to match what just occured. (Switch from 1 to 0)
  LastLifeButtonState = ButtonStatus;
}

void readFunButton(){

  // Let's pull the current button state.
  int ButtonStatus = digitalRead(FUN_BUTTON);

  // Press event (flag IsButtonPressed)
  if (ButtonStatus == 0 && LastFunButtonState == 1){
    IsFunButtonPressed = true;
  }

  // This is the logic that controls the white LED when the button is pressed (for debugging)
  if (ButtonStatus == 0){
    display.drawBitmap(0,0, epd_bitmap_LikeScreenTwo, SCREEN_WIDTH, SCREEN_HEIGHT, 1);
    display.display();
  } else{
    
  }

  // Update the last button state to match what just occured. (Switch from 1 to 0)
  LastFunButtonState = ButtonStatus;
}

void DeathTime(){
	// If TimeOfDeath is 0, disregard
	if (TimeOfDeath == 0) return;

// Time calculation
  unsigned long elapsedMillis = TimeOfDeath- timeElapsed;
  unsigned int seconds = (elapsedMillis / 1000) % 60;
  unsigned int minutes = (elapsedMillis / 60000);

  // Printing the time calculated at the bottom of the Death Screen
  display.setTextSize(1);
  display.setTextColor(SSD1306_BLACK);
  display.setCursor(55,55);
  display.print(minutes);
  display.print(":");
  if (seconds < 10) display.print("0");
  display.print(seconds);
  display.display();
}

// This function controls the Heartbeat animation achieved by cycling between both DefaultScreen & Heartbeat
void HeartBeat(){
  static unsigned long lastUpdate = 0;
  static bool toggle = false;

  // This if ensures the screen is wiped each time
  if (millis() - lastUpdate >= 500){
    lastUpdate = millis();
    toggle = !toggle;

    display.clearDisplay();
    
  // Switching between the two screens
  if (life > 0){
  if (toggle){
    display.drawBitmap(0,0, epd_bitmap_DefaultScreenTwo, SCREEN_WIDTH, SCREEN_HEIGHT, 1);
  } else {
    display.drawBitmap(0,0, epd_bitmap_HeartBeatTwo, SCREEN_WIDTH, SCREEN_HEIGHT,1);
  }
} else { // If life is at 0, the program is "dead", this displays the death screen.
  display.drawBitmap(0,0, epd_bitmap_DeathScreenTwo, SCREEN_WIDTH, SCREEN_HEIGHT, 1);
  DeathTime();
}
display.display();
  }
}

// This function handles the FunButton and determines if its been pressed or not
void HandleFun(){
  if (IsFunButtonPressed){
    IsFunButtonPressed = false;
  }
}

// This function handles the life functions including + and - life based on time in mills() and button presses
void Lifespan(){

  // We begin by checking the button flag from readButton(), and then adding to it each time for a press.
  if (IsLifeButtonPressed){
    life += CPR;
    if (life > MaxLife){
      life = MaxLife;
    } 
	// Resetting TimeOfDeath on another press that brings up life from 0 to a value
    if (life > 0 && TimeOfDeath != 0) {
      TimeOfDeath = 0;
	  timeElapsed = millis();
    }
	// Reset after flagging
    IsLifeButtonPressed = false;
  }

  // Death Countdown (if button is not pressed)
  unsigned long currentTime = millis();
  if (currentTime - lastDecTime >= DecTime){
      if(life > 0){
        life -= DecAmt;
      }
    lastDecTime = currentTime;
  }

  // Death (life hits zero; Red LED activates to signal death)
  if(life <= 0){
    if(TimeOfDeath == 0){
      TimeOfDeath = millis();
    }
	// Else, reset life back to 0
    life = 0;
    digitalWrite(RED, LOW);
  } else{
    digitalWrite(RED, HIGH);
  }

  
}

void loop() {
  /* The code in the loop runs repeatedly
     We only need to call the functions since they cover all the operations as of now.
  */
  readLifeButton();
  readFunButton();
  HandleFun();
  HeartBeat();
  Lifespan();
}